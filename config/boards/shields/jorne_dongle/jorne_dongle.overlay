/*
 * =============================================================================
 * jorne_dongle.overlay
 *
 * Версия: 1.0.0
 * Автор:  Evgeniy Moskovkin
 *
 * ВАЖНО, прочитайте перед сборкой:
 *   Донгл физически не подключён к матрице клавиш Jorne — у него их просто
 *   нет. Поэтому этому overlay нужна ТОЛЬКО общая "физическая раскладка"
 *   (physical layout / matrix transform) из апстримного шилда "jorne", а не
 *   узел kscan с реальными GPIO.
 *
 *   Официальный jorne.dtsi лежит здесь (нужен для сверки имён узлов):
 *     https://github.com/zmkfirmware/zmk/tree/main/app/boards/shields/jorne
 *
 *   Порядок действий:
 *     1. Откройте jorne.dtsi из апстрима и найдите узел с раскладкой
 *        (обычно физически описан через chosen "zmk,physical-layout" /
 *        "zmk,matrix-transform" — в актуальных версиях ZMK вынесено в
 *        отдельный .dtsi с описанием положений клавиш).
 *     2. Скопируйте сюда именно объявление физической раскладки (без
 *        секции col-gpios/row-gpios с реальными пинами — они донглу не
 *        нужны).
 *     3. Ниже оставлена рабочая заглушка: она подключает общий файл
 *        "jorne.dtsi" целиком. Это самый надёжный вариант "из коробки" —
 *        неиспользуемые GPIO матрицы на донгле просто не будут ни к чему
 *        подключены и не помешают работе, т.к. мы НЕ объявляем
 *        `chosen { zmk,kscan = ...; }` в этом файле (значит опрос матрицы
 *        на донгле не запускается).
 * =============================================================================
 */

#include <dt-bindings/zmk/matrix_transform.h>
#include "jorne.dtsi"

/ {
    chosen {
        /* Явно НЕ указываем zmk,kscan — у донгла нет своей клавиатурной матрицы */
        zmk,physical-layout = &default_layout;
    };
};
