/*
 * =============================================================================
 * jorne_dongle.keymap
 *
 * Версия: 1.0.0
 * Автор:  Evgeniy Moskovkin
 *
 * ВАЖНО:
 *   Логику клавиш (какая клавиша что печатает, слои, hold-tap и т.д.)
 *   обрабатывает ЦЕНТРАЛЬНОЕ устройство — то есть теперь это донгл, а не
 *   левая половинка. Значит именно сюда нужно перенести содержимое layers
 *   /behaviors из оригинального:
 *     https://github.com/zmkfirmware/zmk/blob/main/app/boards/shields/jorne/jorne.keymap
 *   (или из вашего кастомного jorne.keymap, если вы уже его редактировали).
 *
 *   Ниже — только необходимый каркас файла. Скопируйте секции
 *   `/ { behaviors { ... }; keymap { ... }; };` из исходного jorne.keymap
 *   поверх этого файла, ничего в структуре менять не нужно — количество
 *   позиций клавиш (bindings) должно совпадать с физической раскладкой,
 *   подключённой в jorne_dongle.overlay.
 * =============================================================================
 */

#include <behaviors.dtsi>
#include <dt-bindings/zmk/keys.h>
#include <dt-bindings/zmk/bt.h>

/ {
    keymap {
        compatible = "zmk,keymap";

        default_layer {
            // TODO: вставьте сюда реальный массив bindings из jorne.keymap
            bindings = <
                &none
            >;
        };
    };
};
